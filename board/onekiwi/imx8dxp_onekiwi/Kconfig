## board/onekiwi/imx8dxp_onekiwi/Kconfig
```kconfig
if TARGET_IMX8DXP_ONEKIWI

config SYS_BOARD
	default "imx8dxp_onekiwi"

config SYS_VENDOR
	default "onekiwi"

config SYS_CONFIG_NAME
	default "imx8dxp_onekiwi"

config IMX_CONFIG
	default "board/onekiwi/imx8dxp_onekiwi/imximage.cfg"

endif
```

## board/onekiwi/imx8qxp_onekiwi/Kconfig
```kconfig
if TARGET_IMX8QXP_ONEKIWI

config SYS_BOARD
	default "imx8qxp_onekiwi"

config SYS_VENDOR
	default "onekiwi"

config SYS_CONFIG_NAME
	default "imx8qxp_onekiwi"

config IMX_CONFIG
	default "board/onekiwi/imx8qxp_onekiwi/imximage.cfg"

endif
```

## board/variscite/imx8qxp_variscite/Kconfig
```kconfig
if TARGET_IMX8QXP_VARISCITE

config SYS_BOARD
	default "imx8qxp_variscite"

config SYS_VENDOR
	default "variscite"

config SYS_CONFIG_NAME
	default "imx8qxp_variscite"

config IMX_CONFIG
	default "board/variscite/imx8qxp_variscite/imximage.cfg"

endif
```
